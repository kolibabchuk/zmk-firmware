## app/boards/arm/hallie/Kconfig.board
```kconfig
config BOARD_HALLIE_LEFT
	select SOC_NRF52840_QIAA

config BOARD_HALLIE_RIGHT
	select SOC_NRF52840_QIAA

config TEST_MODE
	bool "test_mode"
```

## app/boards/arm/hallie/board.yml
```yaml
boards:
  - name: hallie_left
    vendor: splitted.space
    socs:
      - name: nrf52840
  - name: hallie_right
    vendor: splitted.space
    socs:
      - name: nrf52840
```

## app/boards/arm/hallie/hallie_left_defconfig
```kconfig
CONFIG_ZMK_SPLIT=y
CONFIG_BOARD_HALLIE_LEFT=y
CONFIG_ZMK_SPLIT_ROLE_CENTRAL=y

CONFIG_SOC_SERIES_NRF52X=y
CONFIG_SOC_NRF52840_QIAA=y
CONFIG_BUILD_OUTPUT_UF2=y

CONFIG_ZMK_USB=y
CONFIG_ZMK_BLE=y

# Keyboard name (appears in Bluetooth device list)
CONFIG_ZMK_KEYBOARD_NAME="TYTS-PYZDYTS"

# USB Device IDs - Set to Apple to enable Globe key
CONFIG_USB_DEVICE_VID=0x05AC
CONFIG_USB_DEVICE_PID=0x0267
CONFIG_USB_DEVICE_MANUFACTURER="Apple Inc."

# Enable full consumer HID usage support for Globe key
CONFIG_ZMK_HID_CONSUMER_REPORT_USAGES_FULL=y

CONFIG_ARM_MPU=y
CONFIG_PINCTRL=y
CONFIG_GPIO=y
CONFIG_LED=y

CONFIG_USE_DT_CODE_PARTITION=y

CONFIG_MPU_ALLOW_FLASH_WRITE=y
CONFIG_NVS=y
CONFIG_SETTINGS_NVS=y
CONFIG_FLASH=y
CONFIG_FLASH_PAGE_LAYOUT=y
CONFIG_FLASH_MAP=y
CONFIG_CLOCK_CONTROL_NRF=y
CONFIG_CLOCK_CONTROL_NRF_K32SRC_RC=y

CONFIG_YBM=y
CONFIG_YBM_TRIGGER_GLOBAL_THREAD=y

CONFIG_ZMK_USB_LOGGING=n
CONFIG_LOG_DEFAULT_LEVEL=0
CONFIG_SENSOR_LOG_LEVEL_DBG=n

CONFIG_ZMK_IDLE_TIMEOUT=30000
CONFIG_ZMK_SLEEP=y
CONFIG_ZMK_IDLE_SLEEP_TIMEOUT=300000

CONFIG_ZMK_SPLIT_BLE_CENTRAL_BATTERY_LEVEL_FETCHING=y
CONFIG_ZMK_SPLIT_BLE_CENTRAL_BATTERY_LEVEL_PROXY=y

CONFIG_ZMK_LED_WIDGETS=y

# ZMK Studio disabled - Hallie doesn't have required UART device tree config
# CONFIG_ZMK_STUDIO is not set
CONFIG_ZMK_STUDIO_LOCKING=n

CONFIG_ZMK_POINTING=y
```

## app/boards/arm/harper/Kconfig.board
```kconfig
config BOARD_HARPER_LEFT
	select SOC_NRF52840_QIAA

config BOARD_HARPER_RIGHT
	select SOC_NRF52840_QIAA

config TEST_MODE
	bool "test_mode"
```

## app/boards/arm/harper/board.yml
```yaml
boards:
  - name: harper_left
    vendor: splitted.space
    socs:
      - name: nrf52840
  - name: harper_right
    vendor: splitted.space
    socs:
      - name: nrf52840
```

## app/module/drivers/sensor/ybm/Kconfig
```kconfig
menuconfig YBM
    bool "BM Incremental Encoder Sensor from YSA"
    default y
    depends on DT_HAS_YSA_YBM_ENABLED
    depends on GPIO
    help
      Enable driver for BM YSA incremental encoder sensors.

if YBM

choice YBM_TRIGGER_MODE
    prompt "Trigger mode"
    default YBM_TRIGGER_NONE
    help
      Specify the type of triggering to be used by the driver.

config YBM_TRIGGER_NONE
    bool "No trigger"

config YBM_TRIGGER_GLOBAL_THREAD
    bool "Use global thread"
    depends on GPIO
    select YBM_TRIGGER

config YBM_TRIGGER_OWN_THREAD
    bool "Use own thread"
    depends on GPIO
    select YBM_TRIGGER

endchoice

config YBM_TRIGGER
    bool

config YBM_THREAD_PRIORITY
    int "Thread priority"
    depends on YBM_TRIGGER_OWN_THREAD
    default 10
    help
      Priority of thread used by the driver to handle interrupts.

config YBM_THREAD_STACK_SIZE
    int "Thread stack size"
    depends on YBM_TRIGGER_OWN_THREAD
    default 1024
    help
      Stack size of thread used by the driver to handle interrupts.

endif # YBM
```
